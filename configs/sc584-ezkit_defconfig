## configs/sc584-ezkit_defconfig
```kconfig
CONFIG_ARM=y
CONFIG_SPL_SKIP_LOWLEVEL_INIT=y
CONFIG_SYS_ARM_CACHE_WRITETHROUGH=y
CONFIG_ARCH_SC5XX=y
CONFIG_TEXT_BASE=0x89200000
CONFIG_SYS_MALLOC_LEN=0x100000
CONFIG_SYS_MALLOC_F_LEN=0x14000
CONFIG_SPL_GPIO=y
CONFIG_SPL_LIBCOMMON_SUPPORT=y
CONFIG_SPL_LIBGENERIC_SUPPORT=y
CONFIG_NR_DRAM_BANKS=1
CONFIG_HAS_CUSTOM_SYS_INIT_SP_ADDR=y
CONFIG_CUSTOM_SYS_INIT_SP_ADDR=0x8903f000
CONFIG_SF_DEFAULT_SPEED=5000000
CONFIG_ENV_SIZE=0x4000
CONFIG_ENV_OFFSET=0xD0000
CONFIG_ENV_SECT_SIZE=0x4000
CONFIG_DM_GPIO=y
CONFIG_DEFAULT_DEVICE_TREE="sc584-ezkit"
CONFIG_SPL_TEXT_BASE=0x20080000
CONFIG_SPL_SERIAL=y
CONFIG_SPL_STACK=0x200C0000
CONFIG_TARGET_SC584_EZKIT=y
CONFIG_WATCHDOG_TIMEOUT_MSECS=60000
CONFIG_ADI_BUG_EZKHW21=y
CONFIG_CGU0_DF_DIV=0
CONFIG_CGU0_VCO_MULT=18
CONFIG_CGU0_CCLK_DIV=1
CONFIG_CGU0_SCLK_DIV=2
CONFIG_CGU0_SCLK0_DIV=2
CONFIG_CGU0_SCLK1_DIV=2
CONFIG_CGU0_DCLK_DIV=2
CONFIG_CGU0_OCLK_DIV=3
CONFIG_CGU0_CLKOUTSEL=7
CONFIG_CGU1_DF_DIV=0
CONFIG_CGU1_VCO_MULT=5
CONFIG_CGU1_CCLK_DIV=1
CONFIG_CGU1_SCLK_DIV=2
CONFIG_CGU1_SCLK0_DIV=2
CONFIG_CGU1_SCLK1_DIV=2
CONFIG_CGU1_DCLK_DIV=2
CONFIG_CGU1_OCLK_DIV=3
CONFIG_CDU0_CLKO0=1
CONFIG_CDU0_CLKO1=1
CONFIG_CDU0_CLKO2=1
CONFIG_CDU0_CLKO3=1
CONFIG_CDU0_CLKO4=1
CONFIG_CDU0_CLKO5=1
CONFIG_CDU0_CLKO6=1
CONFIG_CDU0_CLKO7=5
CONFIG_CDU0_CLKO8=1
CONFIG_CDU0_CLKO9=1
CONFIG_SPL_SYS_MALLOC_F_LEN=0x8000
CONFIG_SPL=y
CONFIG_SYS_LOAD_ADDR=0x0
CONFIG_FIT=y
CONFIG_FIT_SIGNATURE=y
CONFIG_LEGACY_IMAGE_FORMAT=y
CONFIG_SYS_BOOTM_LEN=0x1800000
CONFIG_USE_BOOTCOMMAND=y
CONFIG_BOOTCOMMAND="run ramboot"
CONFIG_SYS_CBSIZE=512
CONFIG_SPL_MAX_SIZE=0x20000
CONFIG_SPL_HAS_BSS_LINKER_SECTION=y
CONFIG_SPL_BSS_START_ADDR=0x200A0000
CONFIG_SPL_BSS_MAX_SIZE=0x8000
CONFIG_SPL_BOOTROM_SUPPORT=y
# CONFIG_SPL_RAW_IMAGE_SUPPORT is not set
# CONFIG_SPL_SHARES_INIT_SP_ADDR is not set
CONFIG_SPL_I2C=y
CONFIG_CMD_BOOTZ=y
# CONFIG_BOOTM_NETBSD is not set
# CONFIG_BOOTM_PLAN9 is not set
# CONFIG_BOOTM_RTEMS is not set
# CONFIG_BOOTM_VXWORKS is not set
# CONFIG_CMD_ELF is not set
CONFIG_CMD_DM=y
CONFIG_CMD_GPIO=y
CONFIG_CMD_I2C=y
# CONFIG_CMD_PINMUX is not set
CONFIG_CMD_SPI=y
CONFIG_CMD_USB=y
CONFIG_CMD_DHCP=y
CONFIG_SYS_DISABLE_AUTOLOAD=y
CONFIG_CMD_MII=y
# CONFIG_CMD_MDIO is not set
CONFIG_CMD_PING=y
CONFIG_CMD_DNS=y
CONFIG_CMD_EXT4=y
CONFIG_CMD_EXT4_WRITE=y
CONFIG_CMD_FAT=y
CONFIG_CMD_FS_GENERIC=y
CONFIG_SPL_OF_CONTROL=y
CONFIG_OF_EMBED=y
# CONFIG_OF_TAG_MIGRATE is not set
CONFIG_ENV_OVERWRITE=y
CONFIG_ENV_IS_IN_SPI_FLASH=y
CONFIG_ENV_SPI_MAX_HZ=10000000
CONFIG_USE_HOSTNAME=y
CONFIG_HOSTNAME="sc58x"
CONFIG_NET_RETRY_COUNT=20
CONFIG_IP_DEFRAG=y
CONFIG_USE_GATEWAYIP=y
CONFIG_GATEWAYIP="192.168.0.1"
CONFIG_USE_IPADDR=y
CONFIG_IPADDR="192.168.0.15"
CONFIG_USE_NETMASK=y
CONFIG_NETMASK="255.255.255.0"
CONFIG_USE_ROOTPATH=y
CONFIG_ROOTPATH="/romfs"
CONFIG_USE_SERVERIP=y
CONFIG_SERVERIP="192.168.0.2"
CONFIG_SPL_DM=y
CONFIG_SPL_DM_SEQ_ALIAS=y
CONFIG_SPL_CLK=y
CONFIG_SPL_CLK_CCF=y
CONFIG_GPIO_HOG=y
CONFIG_SPL_GPIO_HOG=y
CONFIG_DM_GPIO_LOOKUP_LABEL=y
CONFIG_SPL_DM_GPIO_LOOKUP_LABEL=y
CONFIG_MCP230XX_GPIO=y
CONFIG_DM_I2C=y
CONFIG_DM_I2C_GPIO=y
CONFIG_SYS_I2C_ADI=y
CONFIG_MTD=y
CONFIG_DM_SPI_FLASH=y
CONFIG_SF_DEFAULT_BUS=2
CONFIG_SF_DEFAULT_CS=1
CONFIG_SPI_FLASH_WINBOND=y
CONFIG_ETH_DESIGNWARE=y
CONFIG_DW_ALTDESCRIPTOR=y
CONFIG_PINCTRL=y
# CONFIG_PINCTRL_GENERIC is not set
CONFIG_SPL_PINCTRL=y
# CONFIG_SPL_PINCTRL_GENERIC is not set
CONFIG_SPECIFY_CONSOLE_INDEX=y
CONFIG_DM_SERIAL=y
CONFIG_SPI=y
CONFIG_DM_SPI=y
CONFIG_ADI_SPI3=y
CONFIG_SPL_TIMER=y
CONFIG_USB=y
CONFIG_USB_MUSB_HOST=y
CONFIG_USB_MUSB_SC5XX=y
CONFIG_USB_MUSB_PIO_ONLY=y
CONFIG_USB_STORAGE=y
CONFIG_FAT_WRITE=y
# CONFIG_REGEX is not set
# CONFIG_EFI_LOADER is not set
```

## configs/sc594-som-ezkit-spl_defconfig
```kconfig
CONFIG_ARM=y
CONFIG_SPL_SKIP_LOWLEVEL_INIT=y
CONFIG_SYS_ARM_CACHE_WRITETHROUGH=y
CONFIG_ARCH_SC5XX=y
CONFIG_TEXT_BASE=0xB2200000
CONFIG_SYS_MALLOC_LEN=0x100000
CONFIG_SYS_MALLOC_F_LEN=0x14000
CONFIG_SPL_GPIO=y
CONFIG_SPL_LIBCOMMON_SUPPORT=y
CONFIG_SPL_LIBGENERIC_SUPPORT=y
CONFIG_NR_DRAM_BANKS=1
CONFIG_HAS_CUSTOM_SYS_INIT_SP_ADDR=y
CONFIG_CUSTOM_SYS_INIT_SP_ADDR=0x8203f000
CONFIG_SF_DEFAULT_SPEED=10000000
CONFIG_ENV_SIZE=0x20000
CONFIG_ENV_OFFSET=0x100000
CONFIG_ENV_SECT_SIZE=0x20000
CONFIG_DM_GPIO=y
CONFIG_SPL_DM_SPI=y
CONFIG_DEFAULT_DEVICE_TREE="sc594-som-ezkit"
CONFIG_SPL_TEXT_BASE=0x20080000
CONFIG_SPL_SERIAL=y
CONFIG_SPL_STACK=0x200E4000
CONFIG_TARGET_SC594_SOM_EZKIT=y
CONFIG_SC_BOOT_MODE=2
CONFIG_ADI_CARRIER_SOMCRR_EZKIT=y
CONFIG_CGU0_DF_DIV=0
CONFIG_CGU0_VCO_MULT=80
CONFIG_CGU0_CCLK_DIV=2
CONFIG_CGU0_SCLK_DIV=4
CONFIG_CGU0_SCLK0_DIV=4
CONFIG_CGU0_DCLK_DIV=2
CONFIG_CGU0_OCLK_DIV=16
CONFIG_CGU0_DIV_S1SELEX=6
CONFIG_CGU1_DF_DIV=0
CONFIG_CGU1_VCO_MULT=64
CONFIG_CGU1_CCLK_DIV=2
CONFIG_CGU1_SCLK_DIV=4
CONFIG_CGU1_SCLK0_DIV=4
CONFIG_CGU1_DCLK_DIV=2
CONFIG_CGU1_OCLK_DIV=16
CONFIG_CGU1_DIV_S1SELEX=16
CONFIG_CDU0_CLKO0=1
CONFIG_CDU0_CLKO1=1
CONFIG_CDU0_CLKO2=1
CONFIG_CDU0_CLKO3=3
CONFIG_CDU0_CLKO4=3
CONFIG_CDU0_CLKO5=1
CONFIG_CDU0_CLKO6=1
CONFIG_CDU0_CLKO7=1
CONFIG_CDU0_CLKO8=3
CONFIG_CDU0_CLKO9=1
CONFIG_CDU0_CLKO10=5
CONFIG_CDU0_CLKO12=1
CONFIG_SPL_SYS_MALLOC_F_LEN=0x10000
CONFIG_SPL=y
CONFIG_SYS_LOAD_ADDR=0x0
# CONFIG_SYS_MALLOC_CLEAR_ON_INIT is not set
CONFIG_FIT=y
CONFIG_FIT_SIGNATURE=y
CONFIG_LEGACY_IMAGE_FORMAT=y
CONFIG_SYS_BOOTM_LEN=0x1800000
CONFIG_USE_BOOTCOMMAND=y
CONFIG_BOOTCOMMAND="run ospiboot"
CONFIG_SYS_CBSIZE=512
CONFIG_SPL_MAX_SIZE=0x30000
CONFIG_SPL_HAS_BSS_LINKER_SECTION=y
CONFIG_SPL_BSS_START_ADDR=0x200B0000
CONFIG_SPL_BSS_MAX_SIZE=0x10000
CONFIG_SPL_BOOTROM_SUPPORT=y
# CONFIG_SPL_SHARES_INIT_SP_ADDR is not set
CONFIG_SPL_I2C=y
CONFIG_SPL_DM_SPI_FLASH=y
CONFIG_CMD_BOOTZ=y
CONFIG_CMD_DM=y
CONFIG_CMD_GPIO=y
# CONFIG_CMD_PINMUX is not set
CONFIG_CMD_SPI=y
CONFIG_CMD_USB=y
CONFIG_CMD_DHCP=y
CONFIG_SYS_DISABLE_AUTOLOAD=y
CONFIG_CMD_MII=y
# CONFIG_CMD_MDIO is not set
CONFIG_CMD_PING=y
CONFIG_CMD_EXT4=y
CONFIG_CMD_FAT=y
CONFIG_OF_EMBED=y
# CONFIG_OF_TAG_MIGRATE is not set
CONFIG_ENV_OVERWRITE=y
CONFIG_ENV_IS_IN_SPI_FLASH=y
CONFIG_USE_HOSTNAME=y
CONFIG_HOSTNAME="sc59x"
CONFIG_NET_RETRY_COUNT=20
CONFIG_IP_DEFRAG=y
CONFIG_USE_GATEWAYIP=y
CONFIG_GATEWAYIP="192.168.0.1"
CONFIG_USE_IPADDR=y
CONFIG_IPADDR="192.168.0.15"
CONFIG_USE_NETMASK=y
CONFIG_NETMASK="255.255.255.0"
CONFIG_USE_ROOTPATH=y
CONFIG_ROOTPATH="/romfs"
CONFIG_USE_SERVERIP=y
CONFIG_SERVERIP="192.168.0.2"
CONFIG_SPL_DM_SEQ_ALIAS=y
CONFIG_DM_DMA=y
CONFIG_DMA=y
CONFIG_DMA_CHANNELS=y
CONFIG_ADI_DMA=y
CONFIG_GPIO_HOG=y
CONFIG_SPL_GPIO_HOG=y
CONFIG_DM_GPIO_LOOKUP_LABEL=y
CONFIG_SPL_DM_GPIO_LOOKUP_LABEL=y
CONFIG_MCP230XX_GPIO=y
CONFIG_DM_I2C=y
CONFIG_DM_I2C_GPIO=y
CONFIG_SYS_I2C_ADI=y
CONFIG_MTD=y
CONFIG_DM_SPI_FLASH=y
CONFIG_SPI_FLASH_SFDP_SUPPORT=y
CONFIG_SPI_FLASH_SOFT_RESET=y
CONFIG_SPI_FLASH_HS_CALIB=y
CONFIG_SPI_FLASH_ISSI=y
CONFIG_SPI_FLASH_MTD=y
CONFIG_ETH_DESIGNWARE=y
CONFIG_DW_ALTDESCRIPTOR=y
CONFIG_PHY=y
CONFIG_PINCTRL=y
# CONFIG_PINCTRL_GENERIC is not set
CONFIG_SPL_PINCTRL=y
# CONFIG_SPL_PINCTRL_GENERIC is not set
CONFIG_SPECIFY_CONSOLE_INDEX=y
CONFIG_DM_SERIAL=y
CONFIG_SPI=y
CONFIG_DM_SPI=y
CONFIG_ADI_SPI3=y
CONFIG_CADENCE_QSPI=y
CONFIG_SPL_TIMER=y
CONFIG_USB=y
CONFIG_USB_DWC2=y
CONFIG_USB_STORAGE=y
CONFIG_SPL_OF_LIBFDT_ASSUME_MASK=0x0
```
